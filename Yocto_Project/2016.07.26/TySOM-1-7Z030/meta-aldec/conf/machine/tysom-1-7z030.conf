## Yocto_Project/2016.07.26/TySOM-1-7Z030/meta-aldec/conf/machine/tysom-1-7z030.conf
```bitbake
#@TYPE: Machine
#@NAME: TySOM-1-7Z030
#@DESCRIPTION: Machine support for TySOM-1-7Z030 Evaluation Board.
#
# For details on the Evaluation board:
#     https://www.aldec.com/en/products/tysom_system_on_module
#

require conf/machine/include/tune-zynq.inc
require conf/machine/include/machine-xilinx-default.inc
require conf/machine/include/machine-xilinx-board.inc

MACHINE_FEATURES = "rtc ext2 ext3 vfat usbhost"

UBOOT_MACHINE = "zynq_tysom_1_7z030_config"
SPL_BINARY = "spl/boot.bin"

PREFERRED_PROVIDER_virtual/kernel ?= "linux-adi"
PREFERRED_VERSION_linux-adi ?= "4.4%"

SERIAL_CONSOLE = "115200 ttyPS0"
```
